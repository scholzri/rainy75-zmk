## zmk/boards/rainy75/Kconfig.defconfig
```kconfig
if BOARD_RAINY75

config SOC_FLASH_TELINK_B91
	default y if FLASH

config WDT_B91
	default y
	depends on WDT

# ---- Multi-level IRQ fix ----
# The PLIC driver selects MULTI_LEVEL_INTERRUPTS + 2ND_LEVEL_INTERRUPTS.
# The B91 SoC defconfig omits MAX_IRQ_PER_AGGREGATOR, leaving it at 0.
# With 0, PLIC_MIN_IRQ_NUM = MIN(riscv_ndev=63, 0) = 0, causing ALL PLIC
# interrupts to be treated as spurious (z_irq_spurious crash).
#
# We also set 2ND_LVL_ISR_TBL_OFFSET=12 to separate the PLIC ISR table
# from level-1 entries (MTIP=7, MEIP=11).  Without this, PLIC source 7
# (USB_SETUP) collides with MTIP, and PLIC source 11 (USB_ENDPOINT)
# collides with MEI (the PLIC handler itself).
#
# The mtimer DTS is overridden in rainy75.dts to use <&hlic 7> so that
# the timer ISR stays at _sw_isr_table[7] (level-1 direct dispatch).
#
# NUM_IRQS = 12 (level-1) + 64 (PLIC sources) = 76.

config MAX_IRQ_PER_AGGREGATOR
	default 64

config 2ND_LVL_ISR_TBL_OFFSET
	default 12

config NUM_IRQS
	default 76

endif # BOARD_RAINY75
```

## zmk/boards/rainy75/Kconfig.rainy75
```kconfig
config BOARD_RAINY75
	select SOC_TLSR9518
	select HAS_POWEROFF

# Note: the ISO/ANSI physical layout is NOT a Kconfig option. A Kconfig symbol
# can't drive it, because the keymap + matrix transform are devicetree, which is
# preprocessed before Kconfig runs. ANSI is selected via the devicetree
# preprocessor symbol RAINY75_ANSI — build with `./build.sh --ansi` (which passes
# -DDTS_EXTRA_CPPFLAGS=-DRAINY75_ANSI). See rainy75.keymap / rainy75.dts.
```

## zmk/boards/rainy75/rainy75_defconfig
```kconfig
# Core hardware (shared by MCUboot and application)
CONFIG_GPIO=y
CONFIG_PINCTRL=y
CONFIG_WARN_DEPRECATED=n

# Flash (B91 flash driver uses k_malloc)
CONFIG_HEAP_MEM_POOL_SIZE=4096
CONFIG_FLASH=y
CONFIG_FLASH_MAP=y
CONFIG_FLASH_PAGE_LAYOUT=y
```

## zmk/drivers/bluetooth/Kconfig
```kconfig
config BT_HCI_B91
	bool "Telink B91 BLE HCI driver"
	default y
	depends on BT && DT_HAS_TELINK_B91_BT_HCI_ENABLED
	select BT_HAS_HCI_VS
	help
	  Bluetooth HCI driver for the Telink B91 (TLSR951x) SoC.
	  Uses our own shim around the BLE controller blob
	  (liblt_9518_zephyr.a) from telink-semi/zephyr_hal_telink_b91_ble_lib.

config BT_HCI_B91_RX_STACK_SIZE
	int "B91 BLE RX thread stack size"
	depends on BT_HCI_B91
	default 2048

config BT_HCI_B91_RX_PRIO
	int "B91 BLE RX thread priority"
	depends on BT_HCI_B91
	default 2
```

## zmk/drivers/led_strip/Kconfig
```kconfig
config LED_STRIP_B91_SPI
	bool "Telink B91 SPI WS2812 LED strip driver"
	default y
	depends on SOC_SERIES_TLSR951X
	select LED_STRIP
	help
	  WS2812 LED strip driver using the B91's PSPI peripheral and DMA.
	  Data pin: PB7 (PSPI MOSI). SPI clock: 6 MHz. DMA channel 4.

config LED_STRIP_B91_SPI_PC2_POWER
	bool "Drive PC2 HIGH for LED power enable"
	depends on LED_STRIP_B91_SPI
	help
	  PC2 controls a MOSFET gate for LED VCC (active-high = power ON).
	  Without this, the WS2812 LED strip has no power supply.
	  Confirmed on hardware: PC2 HIGH = LEDs powered, PC2 LOW = LEDs off.
```

## zmk/drivers/sensor/Kconfig
```kconfig
config BATTERY_B91_ADC
	bool "Telink B91 battery voltage sensor (SAR ADC)"
	default n
	depends on SOC_SERIES_TLSR951X
	select SENSOR
	help
	  Battery voltage sensor using the B91's 10-channel SAR ADC.
	  ADC channel and voltage divider ratio configured via devicetree.
```

## zmk/drivers/usb/Kconfig
```kconfig
# Copyright (c) 2025 scholzri
# SPDX-License-Identifier: Apache-2.0

config USB_DC_B91
	bool "Telink B91 USB device controller (legacy API)"
	default y
	depends on SOC_SERIES_TLSR951X
	select USB_DEVICE_DRIVER
	select DYNAMIC_INTERRUPTS
	help
	  Legacy usb_dc.h driver for Telink B91 (TLSR9518/9511) SoC.
	  Required for ZMK USB HID support on this platform.
	  Implements USB full-speed with EP0 (8-byte MPS) + EP1-8.
```

## zmk/drivers/watchdog/Kconfig
```kconfig
config WDT_B91
	bool "Telink B91 hardware watchdog driver"
	default y
	depends on SOC_SERIES_TLSR951X
	select WDT
	help
	  Enable the hardware watchdog timer on Telink B91 SoCs.
	  The watchdog resets the entire chip on timeout (no interrupt/callback).
	  Clock source is PCLK (24 MHz). Max timeout ~11 seconds.

module = WDT
module-str = watchdog
source "subsys/logging/Kconfig.template.log_config"
```

## zmk/dts/bindings/behaviors/rainy,behavior-rgb.yaml
```yaml
description: Rainy 75 RGB control behavior
compatible: "rainy,behavior-rgb"
include: one_param.yaml
```

## zmk/dts/bindings/bluetooth/telink,b91-bt-hci.yaml
```yaml
description: Telink B91 Bluetooth HCI Controller
compatible: "telink,b91-bt-hci"
include: bt-hci.yaml
```

## zmk/dts/bindings/led-strip/telink,b91-spi-led-strip.yaml
```yaml
description: Telink B91 SPI-based WS2812 LED strip controller
compatible: "telink,b91-spi-led-strip"

include: led-strip.yaml

properties:
  chain-length:
    type: int
    required: true
    description: Number of WS2812 LEDs in the strip
```

## zmk/dts/bindings/sensor/telink,b91-battery-adc.yaml
```yaml
description: Telink B91 SAR ADC battery voltage sensor
compatible: "telink,b91-battery-adc"

properties:
  adc-channel:
    type: int
    required: true
    description: |
      SAR ADC input mux code for the battery sense pin.
      0x1=PB0, 0x2=PB1, ..., 0x8=PB7, 0x9=PD0, 0xA=PD1.
  divider-numerator:
    type: int
    default: 3
    description: Voltage divider numerator (3 for 3/4 divider)
  divider-denominator:
    type: int
    default: 4
    description: Voltage divider denominator (4 for 3/4 divider)
  full-mv:
    type: int
    default: 4200
    description: Battery voltage at 100% charge (millivolts)
  empty-mv:
    type: int
    default: 3300
    description: Battery voltage at 0% charge (millivolts)
```

## zmk/dts/bindings/usb/telink,b91-udc.yaml
```yaml
# Copyright (c) 2025 scholzri
# SPDX-License-Identifier: Apache-2.0

description: Telink B91 USB device controller

compatible: "telink,b91-udc"

include: usb-ep.yaml

properties:
  reg:
    required: true

  interrupts:
    required: true
    description: |
      Five interrupt specifiers in order:
        0: USB_CTRL_EP_SETUP  (PLIC IRQ 7)
        1: USB_CTRL_EP_DATA   (PLIC IRQ 8)
        2: USB_CTRL_EP_STATUS (PLIC IRQ 9)
        3: USB_ENDPOINT       (PLIC IRQ 11)
        4: USB_RESET          (PLIC IRQ 35)
```

## zmk/dts/bindings/usb/telink,b91-usbd.yaml
```yaml
description: Telink B91 USB device controller

compatible: "telink,b91-usbd"

include: usb-ep.yaml

properties:
  reg:
    required: true

  interrupts:
    required: true
```

## zmk/dts/bindings/watchdog/telink,b91-watchdog.yaml
```yaml
description: Telink B91 hardware watchdog timer

compatible: "telink,b91-watchdog"

include: base.yaml

properties:
  reg:
    required: true
```

## zmk/west.yml
```yaml
manifest:
  remotes:
    - name: zmkfirmware
      url-base: https://github.com/zmkfirmware
    - name: zephyrproject-rtos
      url-base: https://github.com/zephyrproject-rtos
  projects:
    - name: zmk
      remote: zmkfirmware
      # Reachable upstream ZMK. Our one local change (ZMK_USB_NO_VBUS_DETECT, needed
      # for battery deep sleep) is carried as patches/zmk-src/0001 and applied by
      # build.sh — this pin + that patch == the exact source this firmware was built
      # and tested against. Bump the two together if you move the pin.
      revision: 27afcb11efff6345d0ceb875e85c2de0673123f6
      path: zmk-src
      import: app/west.yml
    - name: hal_telink
      remote: zephyrproject-rtos
      revision: main
      path: modules/hal/hal_telink
    - name: mcuboot
      remote: zephyrproject-rtos
      revision: v2.2.0
      path: bootloader/mcuboot
  self:
    path: zmk
```
