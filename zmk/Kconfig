## zmk/Kconfig
```kconfig
rsource "drivers/usb/Kconfig"
rsource "drivers/bluetooth/Kconfig"
rsource "drivers/led_strip/Kconfig"
rsource "drivers/sensor/Kconfig"
rsource "drivers/watchdog/Kconfig"

config BOOT_DIAG
	bool "Boot diagnostic (.noinit SRAM buffer for SWS debug)"
	default n
	help
	  Records boot stage codes to a .noinit SRAM buffer that can be read
	  via SWS/BDT even when USB is not working. Essential for first-flash
	  debugging when USB serial is not yet proven.

	  Read the buffer after flash:
	    addr=$(riscv32-elf-nm build/zephyr/zephyr.elf | grep boot_diag_buf)
	    ./reverse/tools/sws_flash.sh sram 0x<addr> 36

config BOOT_DIAG_GPIO
	bool "Boot diagnostic GPIO heartbeat (PD7)"
	default y
	depends on BOOT_DIAG
	help
	  Toggle PD7 at each boot stage for logic analyzer visibility.
	  Uses direct register access (works before GPIO driver init).
	  PD7 is free on the Rainy 75 (not used by matrix, USB, or RGB).

config RAINY75_MCUBOOT_MANUAL_CONFIRM
	bool "Test image: do not confirm the image automatically"
	depends on IMG_MANAGER
	help
	  For risky test images. The image does not confirm itself after boot;
	  the watchdog is switched off instead, so it can be tested as long as
	  needed. Any reset or power cycle then goes back to the previous image,
	  even if USB and Bluetooth no longer work. Confirm a good test image by
	  hand with "mcumgr image confirm". Never set this for release images.

config FLASH_MGMT
	bool "Raw flash management via mcumgr"
	default n
	depends on MCUMGR && FLASH
	help
	  Adds a custom mcumgr group (ID 64) with raw flash erase/write/read
	  commands. Used to restore original firmware via USB without SWS
	  hardware. Protected region >= 0xFE000 is always refused.

config OPENLL_MGMT
	bool "Power counters via mcumgr (open BLE controller)"
	default n
	depends on MCUMGR && BT_HCI_B91_CTLR_OPEN
	# reply: root map > per-link list > per-link map (canonical zcbor
	# needs a backup state per level)
	select MCUMGR_SMP_CBOR_MIN_ENCODING_LEVEL_3 if ZCBOR_CANONICAL
	help
	  Adds a custom mcumgr group (ID 66) with one read command that returns
	  uptime, connection events planned / listened / skipped, kicks,
	  controller-thread wakeups and battery mV (sums over the links), plus
	  per-link counters and the advertising arbitration counters. Readable
	  over BLE and USB SMP; see reverse/tools/openll_stats.py.

config RAINY75_BLE_OPEN_PROFILE_TIMEOUT
	int "Seconds an explicitly selected open BLE profile waits for a host (0 = off)"
	default 30
	range 0 3600
	depends on ZMK_BLE
	help
	  When the user selects an open (unpaired) BLE profile and no host
	  pairs within this time, the keyboard selects the previously active
	  profile again if it is connected, else the most recently connected
	  profile. If there is none, it stays. A pairing in progress (from the
	  passkey request until it ends) pauses the timer; if it fails or the
	  host leaves, the full timeout starts again. A plain connection does
	  not pause it. A completed pairing, selecting a bonded profile and
	  clearing bonds (BT_CLR: the user wants to pair on the active profile,
	  BT_CLR_ALL) disarm it. The timer lives in RAM only: it does not
	  survive a reboot or deep sleep wake, and selecting the already active
	  open profile again does not restart it. The return keeps the output
	  (USB or BLE) as it is. 0 compiles the feature out.
	  src/ble_open_profile/, raises rainy75_ble_open_profile_timeout.

config RAINY_RGB
	bool "Rainy 75 out-of-tree RGB lighting engine"
	depends on LED_STRIP_B91_SPI
	help
	  Custom WS2812 lighting engine (effects, reactivity, per-key) that
	  replaces ZMK's rgb_underglow. Owns the led_strip device directly.

config RGB_MGMT
	bool "Host-controlled per-key RGB via mcumgr"
	default n
	depends on MCUMGR && RAINY_RGB
	help
	  Adds a custom mcumgr group (ID 65) that lets a host script drive
	  the rainy_rgb engine's direct-pixel mode: set individual keys by
	  keymap position, fill, or clear back to the normal effect. Any
	  physical Fn+RGB control exits host mode.

config RGB_MGMT_HOST_TIMEOUT_S
	int "Seconds of host silence before host mode expires (0 = never)"
	default 30
	range 0 3600
	depends on RGB_MGMT
	help
	  Host mode is released by an explicit clear command, so a host that
	  dies without sending one leaves the board displaying its last frame
	  forever: the idle timer cannot help (host mode deliberately overrides
	  it) and on battery nothing else intervenes. Undocking mid-animation
	  does exactly this — the link dies before the host can retract the
	  frame, and there is then no host left to send anything.

	  Expire host mode when no set/fill has arrived for this long. Host
	  animations refresh continuously (largest gap is well under a second), so
	  this only fires when the host really is gone. Note the trade-off: a
	  deliberately static "fill and walk away" also reverts after this long.
	  Set 0 to disable and restore the old indefinite behaviour.

config RAINY75_CONFIG
	bool "Runtime settings (registry, storage, mcumgr group 67)"
	default n
	depends on MCUMGR && SETTINGS && RAINY_RGB
	# set requests nest root map > "v" list
	select MCUMGR_SMP_CBOR_MIN_DECODING_LEVEL_2
	# list replies nest root map > "s" list > entry list > names list
	select MCUMGR_SMP_CBOR_MIN_ENCODING_LEVEL_4 if ZCBOR_CANONICAL
	help
	  Named settings (rgb.effect, rgb.boot_effect, ...) that a host reads
	  and writes over mcumgr group 67 (USB and Bluetooth), stored in the
	  settings subtree rainy_cfg. See docs/config-protocol.md and
	  reverse/tools/rainy75_cfg.py.

config RAINY_RGB_ANSI_LEDMAP
	bool "ANSI LED map (strip has no LED at the ISO <> slot)"
	depends on RAINY_RGB
	default n
	help
	  The ANSI PCB's WS2812 chain omits the LED under the ISO <> (NUBS)
	  key, so every LED after Left Shift sits one chain index earlier
	  than on the ISO strip (and the last ISO index does not exist).
	  Selects the ANSI-calibrated pos_to_led/XY tables in led_map.c.
	  Set automatically by ./build.sh --ansi.

config RAINY_RGB_WALKER
	bool "Walker diagnostic effect (LED-map calibration)"
	depends on RAINY_RGB
	default n
	help
	  Appends a "walker" effect (last in the Fn+Enter cycle) that lights
	  exactly one LED and steps to the next chain index on each keypress,
	  wrapping. It walks the raw WS2812 chain (0..N-1), independent of the
	  ISO/ANSI pos_to_led map, so it works on either board and is how the
	  ANSI map was ground-truthed. Off by default — enable only when
	  calibrating or debugging the LED order.
```

## zmk/dts/bindings/behaviors/rainy,behavior-os-key.yaml
```yaml
description: GUI or Alt key as the settings kb.os and kb.gui_lock say (parameter LGUI or LALT)
compatible: "rainy,behavior-os-key"
include: one_param.yaml
```
